/*
 * Copyright (C) 2017 Henrik Langer henni19790@googlemail.com
 *
 * This program is free software; you can redistribute it and/or modify
 * it under the terms of the GNU General Public License version 2 as
 * published by the Free Software Foundation.
 */
/dts-v1/;
/plugin/;

/ {
	compatible = "ti,beaglebone", "ti,beaglebone-black", "ti,beaglebone-green";

	/** identification **/
	part-number = "BELA";
	version = "00A0", "A0";

	/** the pin header uses **/
	exclusive-use =

		/* 
			P8.21 and P8.22 are only used for initial configuration
			of tlv320aic3104 via i2c2 => not listed below
		*/

		/* McASP */
		"P9.31",
		"P9.29",
		"P9.28",
		"P9.25",
		"P9.30",

		/* PRU for mutliplexer capelet */
		"P8.41",
		"P8.42",
		"P8.43",
		"P8.44",
		"P8.45",
		"P8.46",

		/* Digital i/o */
		"P8.7",
		"P8.8",
		"P8.9",
		"P8.10",
		"P8.11",
		"P8.12",
		"P9.12",
		"P9.14",
		"P8.15",
		"P8.16",
		"P8.18",
		"P8.27",
		"P8.28",
		"P8.29",
		"P8.30",

		/* Broken out i2c bus on Bela header */
		"P9.26",
		"P9.24",

		/* Bela button */
		"P9.27",

		/* the hardware ip uses */

			/* GPIO */
			"gpio2_2", "gpio2_3", "gpio2_5", "gpio2_4", "gpio1_13", "gpio2_13",
			"gpio1_28", "gpio1_18","gpio1_15", "gpio1_14", "gpio1_19", "gpio2_1",
			"gpio2_22", "gpio2_24", "gpio2_23", "gpio2_25", "gpio3_19",

			/* Misc */
			"mcasp0", "pru0", "pru1", "i2c1";

	/** Dummy property to correctly load device tree overlay **/
	fragment@0 {
		target = <&am33xx_pinmux>;
		__overlay__ {

			
			dummy_pins: pinmux_dummy_pins {
				pinctrl-single,pins = <>;
			};
		};
	};
};
